/*
 * CAUTION: This file is automatically generated by Xilinx.
 * Version:  
 * Today is: Wed Aug  7 13:27:27 2019
 */


&gem0 {
	local-mac-address = [00 0a 35 00 00 00];
};
&gem1 {
	local-mac-address = [00 0a 35 00 00 01];
};
